/*
 * Copyright (c) 2026 ARK Electronics LLC
 * SPDX-License-Identifier: Apache-2.0
 *
 * Pin assignments for the ARK FPV (STM32H743IIK6, UFBGA176 package).
 *
 * The bulk of the pinctrl entries come from the autogenerated upstream file
 * for this package. Board-specific overrides (drive strength, alternative
 * functions, bias tweaks) go inside the &pinctrl block below.
 *
 * Cross-reference every pin against ARK_FPV.PDF (sheets 5/6) before adding
 * an override.
 */

#include <st/h7/stm32h743iikx-pinctrl.dtsi>

&pinctrl {
	/* Board-specific pinctrl overrides land here. None needed yet. */
};
