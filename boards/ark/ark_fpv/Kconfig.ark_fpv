## boards/ark/ark_fpv/Kconfig.ark_fpv
```kconfig
# Copyright (c) 2026 ARK Electronics LLC
# SPDX-License-Identifier: Apache-2.0

config BOARD_ARK_FPV
	select SOC_STM32H743XX
```

## boards/ark/ark_fpv/ark_fpv_defconfig
```kconfig
# Copyright (c) 2026 ARK Electronics LLC
# SPDX-License-Identifier: Apache-2.0

# Cortex-M7 FPU (hard-float ABI is the default once FPU=y is set).
CONFIG_FPU=y

# MPU + HW stack protection
CONFIG_ARM_MPU=y
CONFIG_HW_STACK_PROTECTION=y

# Console on USART3 (PD8/PD9 — matches betaflight DEBUG/MSP assignment).
CONFIG_SERIAL=y
CONFIG_CONSOLE=y
CONFIG_UART_CONSOLE=y

# GPIO + pinctrl + clock control
CONFIG_GPIO=y
CONFIG_PINCTRL=y
CONFIG_CLOCK_CONTROL=y

# LED API — wraps the gpio-leds nodes so the toy app can blink portably.
CONFIG_LED=y

# Soft reset for early bring-up debugging.
CONFIG_REBOOT=y
```

## boards/ark/ark_fpv/board.yml
```yaml
board:
  name: ark_fpv
  full_name: ARK FPV (STM32H743II flight controller)
  vendor: ark
  socs:
    - name: stm32h743xx
```

## west.yml
```yaml
# Copyright (c) 2026 ARK Electronics LLC
# SPDX-License-Identifier: Apache-2.0
#
# West manifest for the ARK FPV Zephyr port.
#
# Layout when initialised from this manifest:
#   <topdir>/                       — workspace root (the parent dir of this repo)
#   <topdir>/zephyr_fpv/             — this manifest repo
#   <topdir>/zephyr-v4.4.0/         — upstream Zephyr (pinned tag, see `path:` below)
#   <topdir>/modules/...            — HAL modules pulled by Zephyr's own manifest
#
# The non-default `path: zephyr-v4.4.0` keeps the upstream checkout from
# colliding with the sibling `zephyr/` reference tree that already lives at
# the topdir for documentation purposes.

manifest:
  remotes:
    - name: zephyrproject-rtos
      url-base: https://github.com/zephyrproject-rtos

  projects:
    - name: zephyr
      remote: zephyrproject-rtos
      revision: v4.4.0
      path: zephyr-v4.4.0
      import:
        # Restrict the imported sub-projects to what an STM32H7 board needs.
        # Add more entries here as later phases land additional dependencies
        # (e.g. tinycrypt, mcuboot, libcanard).
        name-allowlist:
          - cmsis        # legacy ARM CMSIS pulled in by the STM32 HAL
          - cmsis_6      # current ARM CMSIS for Cortex-M
          - hal_stm32    # STM32 HAL — required by the SoC
          - fatfs        # FAT filesystem
          - segger       # SystemView / RTT — optional, useful for debugging
```
